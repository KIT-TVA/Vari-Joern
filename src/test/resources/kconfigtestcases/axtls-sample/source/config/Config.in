## src/test/resources/kconfigtestcases/axtls-sample/source/config/Config.in
```kconfig
#
# For a description of the syntax of this configuration file,
# see scripts/config/Kconfig-language.txt
#

mainmenu "axTLS Sample Configuration"

config HAVE_DOT_CONFIG
    bool
    default y

choice 
    prompt "Platform"
    default CONFIG_PLATFORM_LINUX

config CONFIG_PLATFORM_LINUX
    bool "Linux"

config CONFIG_PLATFORM_CYGWIN
    bool "Cygwin"

config CONFIG_PLATFORM_WIN32
    bool "Win32"

endchoice 

menu "General Configuration"

config PREFIX
    string "axTLS installation prefix"
    depends on !CONFIG_PLATFORM_WIN32
    default "/usr/local"
    help
      Define your directory to install axTLS files/subdirs in.

endmenu

source src/Config.in
```

## src/test/resources/kconfigtestcases/axtls-sample/source/src/Config.in
```kconfig
config CONFIG_USE_GETS
    bool "Have fun with gets"
    default false

config CONFIG_INCLUDE_IO_FILE
   bool "Include a file that contains a method performing I/O operations"
   default true

config CONFIG_PERFORM_CHMOD
   bool "Run chmod on a path"
   default false
   depends on CONFIG_INCLUDE_IO_FILE

config CONFIG_PERFORM_RENAME
   bool "Rename a path"
   default false
   depends on CONFIG_INCLUDE_IO_FILE
```

## src/test/resources/kconfigtestcases/busybox-sample/source/Config.in
```kconfig
#
# For a description of the syntax of this configuration file,
# see docs/Kconfig-language.txt.
#

mainmenu "Configuration"

config WERROR
    bool "Treat warnings as errors"
    default n
    help
      If you say Y here, then warnings will be treated as errors.

source src/Config.in
```

## src/test/resources/kconfigtestcases/fiasco-sample/source/src/Kconfig
```kconfig
choice
        prompt "Architecture"
        default AMD64

config AMD64
        bool "AMD64 processor family"

#  ARCH_CHOICE
endchoice

config XARCH
        string
        default "amd64" if AMD64

config ABI
    string
    default "vf"

menu "Compiling"

config CC
        string "C compiler"
        default "gcc"
        help
          Use this option to override the default C compiler (gcc).

config CXX
        string "C++ compiler"
        default "g++"
        help
          Use this option to override the default C++ compiler (g++).

config LD
        string "LD linker"
        default "ld"
        help
          Use this operation to override the default linker (ld).
          It's especially useful to use the LLVM linker (lld) when using
          Clang/Clang++ for compilation.

config HOST_CC
        string "C host compiler"
        default "gcc"
        help
          Use this option to override the default C host compiler (gcc).

config HOST_CXX
        string "C++ host compiler"
        default "g++"
        help
          Use this option to override the default C++ host compiler (g++).

endmenu

config USE_GETS
    bool "Have fun with gets"
    default false

config INCLUDE_IO_FILE
   bool "Include a file that contains a method performing I/O operations"
   default true

config PERFORM_CHMOD
   bool "Run chmod on a path"
   default false
   depends on INCLUDE_IO_FILE

config PERFORM_RENAME
   bool "Rename a path"
   default false
   depends on INCLUDE_IO_FILE
```

## src/test/resources/kconfigtestcases/linux-sample/source/src/Kconfig
```kconfig
config USE_GETS
    bool "Have fun with gets"
    default false

config INCLUDE_IO_FILE
   bool "Include a file that contains a method performing I/O operations"
   default true

config PERFORM_CHMOD
   bool "Run chmod on a path"
   default false
   depends on INCLUDE_IO_FILE

config PERFORM_RENAME
   bool "Rename a path"
   default false
   depends on INCLUDE_IO_FILE
```

## src/test/resources/kconfigtestcases/sources/busybox-sample/Config.in
```kconfig
#
# For a description of the syntax of this configuration file,
# see docs/Kconfig-language.txt.
#

mainmenu "Configuration"

config HAVE_DOT_CONFIG
	bool
	default y

source src/Config.in
```
